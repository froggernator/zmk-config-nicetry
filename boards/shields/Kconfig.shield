## boards/shields/nicetry/Kconfig.defconfig
```kconfig
if SHIELD_TBOARD_LEFT
  
config ZMK_KEYBOARD_NAME
    default "tBoard"

config ZMK_SPLIT_ROLE_CENTRAL
    default y

endif

if SHIELD_TBOARD_LEFT || SHIELD_TBOARD_RIGHT

config ZMK_SPLIT
    default y

endif
```

## boards/shields/nicetry/Kconfig.shield
```kconfig
config SHIELD_TBOARD_LEFT
    def_bool $(shields_list_contains,tboard_left)

config SHIELD_TBOARD_RIGHT
    def_bool $(shields_list_contains,tboard_right)
```

## boards/shields/nicetry_left/Kconfig.defconfig
```kconfig
if SHIELD_NICETRY_LEFT
  
config ZMK_KEYBOARD_NAME
    default "tboard"

config ZMK_SPLIT_ROLE_CENTRAL
    default y

endif


if SHIELD_NICETRY_LEFT || SHIELD_NICETRY_RIGHT

config ZMK_SPLIT
    default y

endif
```

## boards/shields/nicetry_right/Kconfig.defconfig
```kconfig
if SHIELD_NICETRY_RIGHT
  
config ZMK_KEYBOARD_NAME
    default "nicetry_right"
  
endif
```

## boards/shields/tboard/Kconfig.defconfig
```kconfig
if SHIELD_TBOARD_CENTRAL
config ZMK_SPLIT
    default y
config ZMK_SPLIT_ROLE_CENTRAL
    default y
config ZMK_KEYBOARD_NAME
    default "tBoard"
endif
```

## boards/shields/tboard/Kconfig.shield
```kconfig
config SHIELD_TBOARD_CENTRAL
    def_bool $(shields_list_contains,tboard_central)

config SHIELD_TBOARD_LEFT
    def_bool $(shields_list_contains,tboard_left)

config SHIELD_TBOARD_RIGHT
    def_bool $(shields_list_contains,tboard_right)
```
